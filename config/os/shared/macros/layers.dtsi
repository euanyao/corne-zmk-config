/* Momentary layers. DEV, FNK_NAV and STG are momentary-only via the outer
 * column holds -- releasing the key is the way back. */
MO_MACRO(DEV)
MO_MACRO(AXN)
MO_MACRO(FNK_NAV)
MO_MACRO(STG)

/* Hard reset to base.
 *
 * &to BAS switches every other layer off, WIN included, so the windows
 * variant has to relight it. Toggling after the clear is what makes this
 * idempotent: &to guarantees WIN is off, so &tog always turns it on.
 *
 * macOS is the unflagged default, so to_BAS needs no counterpart there.
 *
 * The trailing F_BAS signal tap was removed with the rest of the layer
 * signals -- see helpers/macros.dtsi.
 */
to_BAS: to_BAS_layer {
    compatible = "zmk,behavior-macro";
    #binding-cells = <0>;
    tap-ms = <MC_LAYERS>;
    bindings = <&to BAS>;
};

to_BAS_win: to_BAS_win_layer {
    compatible = "zmk,behavior-macro";
    #binding-cells = <0>;
    tap-ms = <MC_LAYERS>;
    bindings = <&to BAS &tog WIN>;
};

/* Caps word, with a host signal so the AHK indicator can follow it.
 * Bound to the hold of pos 23 (see ht_CW) -- it used to be a combo on
 * positions 16+19, which was a QWERTY-era choice that landed on T+N here.
 *
 * &cw is self-toggling, so this one macro both arms and cancels caps word.
 * The signal is one-way though: the LA(F13) fires on every press, and
 * nothing fires when caps word auto-deactivates on a space. The AHK
 * indicator therefore goes stale -- it already did, since auto-deactivation
 * was never signalled even when cw_OFF existed. */
cw_ON: cw_ON {
    compatible = "zmk,behavior-macro";
    #binding-cells = <0>;
    bindings
        = <&kp LA(H_CWR)>
        , <&cw>;
};
