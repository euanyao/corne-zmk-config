/* AXN-layer actions, shared across both OSes. */

// tap: \    shift: |
mp_bslh_pipe: morph_bslh_pipe {
    compatible = "zmk,behavior-mod-morph";
    #binding-cells = <0>;
    mods = <(MOD_LSFT|MOD_RSFT)>;
    bindings = <&kp BSLH>, <&kp PIPE>;
};

// tap:     paste    shift:  paste without format
mp_a_paste: morph_action_paste {
    compatible = "zmk,behavior-mod-morph";
    #binding-cells = <0>;
    mods = <(MOD_LSFT|MOD_RSFT)>;
    bindings = <&kp RG(V)>, <&kp RS(RG(V))>;
};
