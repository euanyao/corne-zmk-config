/* BAS -- layer 0, always active.
 *
 * The only layer that binds the outer columns and the thumbs. Everything
 * above is &trans at those positions and inherits them from here, so each
 * exists as a single binding rather than a copy per layer.
 *
 * MAC-CANONICAL, like the whole config: the primary shortcut modifier is
 * Command. See os/shared/keys.dtsi for what that means when adding a
 * Windows-only binding.
 */

        base_layer {
            display-name = "BAS";
            bindings = <
    KEY_ESC  &kp Q  &kp W  &kp F  &kp P  &kp B        &kp J  &kp L      &kp U    &kp Y  &kp SEMI  KEY_BSPC
    KEY_TAB   HR_A   HR_R   HR_S   HR_T  &kp G        &kp M   HR_N       HR_E     HR_I      HR_O   KEY_QUOT
    KEY_DEL   &kp Z  &kp X  &kp C  &kp D  &kp V        &kp K  &kp H  &kp COMMA  &kp DOT  &kp FSLH  KEY_BSLH
                         THU_DEV  KEY_SPC  THU_AXN    THU_AXN  KEY_SPC  &mo_DEV
            >;
        };
