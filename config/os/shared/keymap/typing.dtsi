/* DEV, AXN, FNK_NAV, STG -- layers 2 to 5, shared by both OSes.
 *
 * MAC-CANONICAL. Anything genuinely Windows-specific lives on the WIN
 * overlays in os/windows/keymap/ -- do not add OS branches here.
 *
 * All four are &trans at pos 0 and 12 so the WIN ESC panic reaches through.
 * Word-delete is now at pos 37 (left middle thumb); thumbs are &trans on
 * every typing layer by design, so that override also reaches through.
 * Binding pos 0 for real here silently breaks the ESC panic -- see
 * os/shared/layers.dtsi.
 *
 * Use &none, not &trans, where a layer wants a key to do nothing: &trans
 * falls through to BAS and types a letter.
 */

        dev_layer {
            display-name = "DEV";
            bindings = <
    &trans  &kp AT  &kp POUND  &kp DLLR  &kp PLUS  &kp DQT        &kp TILDE  &kp MINUS  &kp UNDER  &kp PRCNT  &kp CARET  &trans
    &trans  &kp AMPS  &kp LBRC  &kp RBRC  &kp EQUAL  &kp SQT        &kp GRAVE  &kp EXCL  &kp LBKT  &kp RBKT  &kp PIPE  &trans
    &trans   &kp SEMI  &kp LPAR  &kp RPAR  &kp ASTRK  &kp BSLH       &mp_sDEV_s  &kp QMARK     &kp LT     &kp GT  &kp COLON  &kp F12
                            &trans  &trans  &trans        &trans  &trans  &trans
            >;
        };

        act_num_layer {
            /* Left hand shortcuts and clipboard, right hand numpad.
             * WIN_AXN overrides the left-side shortcuts with Ctrl+letter.
             *
             * Row 0, left: Cmd+Sft+4 (screenshot area), then Cmd+W/F/P/B
             * (close, find, print, bold -- Colemak-DH top row letters).
             * Row 1, left: Cmd+A/R/S/T (select-all, reload, save, new-tab --
             * common browser/editor shortcuts at Colemak-DH home row positions)
             * then Cmd+GRAVE (same-app window switch). Right home row keeps
             * hold-tap mods for numpad chord modifiers.
             * Row 2: clipboard -- Cmd+Z/X/C/D/V (undo/cut/copy/dupe/paste).
             */
            #define AX17  &kp  LG(H)          // hide window (Mac); WIN_AXN keeps Ctrl+H here
            display-name = "AXN";
            bindings = <
    &trans  &kp LG(LS(N4))  &kp LG(W)  &kp LG(F)  &kp LG(P)  &kp LG(B)       &kp KP_PLUS  &kp N7  &kp N8  &kp N9  &kp KP_MULTIPLY  &trans
    &trans  &kp LG(A)  &kp LG(R)  &kp LG(S)  &kp LG(T)  AX17             &kp N0  &kp N4  &kp N5  &kp N6  &kp EQUAL  &trans
    &trans  &kp RG(Z)  &kp RG(X)  &kp RG(C)  &kp LG(D)  &kp LG(V)           &kp MINUS  &kp N1  &kp N2  &kp N3    &kp KP_DIVIDE  &trans
                            &trans  &trans  &trans        &trans  &trans  &trans
            >;
        };

        fnk_nav_layer {
            /* F-keys left, navigation + media right.
             *
             * Accessed two ways: hold TAB (pos 12, left outer) or hold RET
             * (pos 23, right outer). Both are momentary-only; there is no
             * latch. Pos 41 (right outer thumb) is &mo_DEV on BAS and falls
             * through to &trans here -- it does not activate FNK_NAV.
             *
             * Left half: F-keys unchanged from the old FNK layout.
             *   Row 0: F9-F12   Row 1: F5-F8 with home-row mods   Row 2: F1-F4
             *
             * Right half: vim arrows on the HOME ROW.
             *
             *   row0: VOL_DN  MUTE  VOL_UP    ·     ·   (outer)
             *   row1:  LEFT   DOWN    UP    RIGHT   ·   (outer)
             *   row2:  HOME   PgDn   PgUp    END    ·   (outer)
             *
             * Positions 18/19/20/21 are the H J K L keys, so LEFT DOWN UP
             * RIGHT land exactly where vim muscle memory expects, on
             * index-in / index / middle / ring. No pinky.
             *
             * Row 2 is the same direction with a bigger jump, on the same
             * four fingers: LEFT->HOME, DOWN->PgDn, UP->PgUp, RIGHT->END.
             *
             * REACH THIS LAYER VIA THE TAB HOLD (pos 12, LEFT hand) so
             * arrowing is cross-hand. The RET hold (pos 23) still works but
             * is same-hand and cramped now that the arrows moved right.
             *
             * The outer column (11/23/35) is &trans again, so BSPC, RET and
             * quote keep working -- and position 11 no longer shadows the
             * WIN word-delete override, which needed a checker exemption
             * while it was bound to END.
             *
             * Position 0 stays &trans so WIN still wins there.
             * &none on unused positions to block BAS fall-through. */
            display-name = "FNK_NAV";
            bindings = <
    &trans  &kp F9  &kp F10  &kp F11  &kp F12  &trans       &kp C_VOL_DN  &kp C_MUTE  &kp C_VOL_UP  &none  &none  &trans
    &trans  &kp F5  &kp F6   &kp F7   &kp F8   &trans          &kp LEFT    &kp DOWN     &kp UP  &kp RIGHT  &none  &trans
    &trans  &kp F1   &kp F2   &kp F3   &kp F4  &trans          &kp HOME  &kp PG_DN  &kp PG_UP    &kp END  &none  &trans
                            &trans  &trans  &trans        &trans  &trans  &trans
            >;
        };

        settings_layer {
            /* Keyboard configuration ONLY -- bootloader, bluetooth, RGB,
             * ZMK Studio and the OS flag. Nothing host-facing.
             *
             * Volume, media transport and screen brightness were removed
             * too. They are OS-independent HID consumer codes so they need
             * no overlay, but they are host controls rather than keyboard
             * config, and are currently bound NOWHERE. FNK has the room.
             *
             * Deliberately carries NO host application shortcuts. The 13
             * that used to live here (zoom, accessibility zoom, screenshot,
             * input source, Finder, Mission Control, force quit, app
             * windows) were the sole reason WIN_STG existed; dropping them
             * let that whole conditional layer go.
             *
             * Consequences worth preserving:
             *   - STG is now OS-independent. Nothing sits above it, so the
             *     class of bug where an overlay silently shadowed the
             *     bootloader keys cannot recur.
             *   - There is room again. BT_CLR is on its own key rather than
             *     buried behind Alt, and 20-odd positions are free.
             *
             * If host shortcuts are wanted later they belong on FNK with a
             * WIN_FNK conditional overlay -- same pattern WIN_STG used, on
             * the layer that has the space for it.
             *
             * &none rather than &trans on unused positions: &trans would
             * fall through to BAS and type a letter. */
            #define ST_UNLOCK  &studio_unlock        // zmk studio unlock
            #define ST_BTCLR   &mp_sSTG_cb           // tap: clear profile | shift: clear ALL profiles
            #define ST_RGB_C    &mp_sSTG_rgb_c
            #define ST_RGB_TOG  &rgb_ug RGB_TOG   // underglow on/off
            #define ST_RGB_EFF  &rgb_ug RGB_EFF   // next effect
            #define ST_RGB_EFR  &rgb_ug RGB_EFR   // previous effect
            #define ST_RGB_U    &mp_sSTG_rgb_u
            #define ST_RGB_D    &mp_sSTG_rgb_d

            /* OS mode toggle, decoupled from the bluetooth profile.
             *
             * The profile macros set the OS as a side effect, which is fine
             * on BLE but leaves two gaps: connecting over USB doesn't touch
             * the profile, and deep-sleep wake resets layer state so the
             * flag is lost while the profile survives. */
            #define ST_OS_TOG   &tog WIN             // macOS <-> Windows mode

            /* Bootloader, one per half, at the top inner corners (pos 5/6).
             *
             * ZMK reset behaviours are source-locality -- they act on the
             * half the key physically sits on -- so each half needs its own
             * binding. Position 5 is left, 6 is right.
             *
             * Reached cross-hand: hold STG on one half (ESC pos 0 or
             * comma pos 11), press the boot key on the other.
             *
             * The case covers the physical reset button, so this is the only
             * route into DFU. Do NOT put these behind a combo -- combos
             * always run on the central and would reset the left half twice.
             *
             * Nothing sits above STG any more, so nothing can shadow these. */
            #define ST_BOOT_L   &bootloader          // DFU, LEFT half
            #define ST_BOOT_R   &bootloader          // DFU, RIGHT half

            display-name = "STG";
            bindings = <
   &none  &m_s_b1  &m_s_b2  ST_RGB_C  &none  ST_BOOT_L        ST_BOOT_R  &none  &none  &none  &none  &none
       &none  &m_s_b3  &m_s_b4  ST_BTCLR  &none  &none        &none      &none  &none     &none  &none      &none
   ST_UNLOCK  &m_s_b5  &m_s_b6  ST_RGB_TOG  ST_RGB_EFF  ST_RGB_EFR        &none      &none  &none  ST_OS_TOG  ST_RGB_U   ST_RGB_D
                            &none  &trans  &trans        &trans  &trans  &none
            >;
        };
