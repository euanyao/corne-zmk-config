/* macOS overlays.
 *
 * MAC is the OS flag: lit means macOS. It is almost entirely &trans -- it
 * exists to be a layer that stays on, because "which layers are active" is
 * the only runtime state ZMK has. It sits above the typing layers so its
 * handful of overrides win.
 *
 * Most of what used to differ between the OSes is gone: with Command and
 * Control swapped per-keyboard on the Mac, a Windows-canonical keycode
 * lands correctly on both. Only combos that are genuinely different
 * chords -- not just a different modifier -- need to appear here.
 *
 * MAC_STG is a conditional layer, activated automatically when MAC is on
 * and STG is active. See the conditional-layers node in corne.keymap.
 *
 * There is deliberately no MAC_AXN: the five macOS-specific AXN keys
 * (expand/shrink selection, replace, redo, =) went unused, so AXN is
 * fully shared now.
 */

        mac_layer {
            /* Three keys. ESC-hold has to relight the flag that &to
             * clears, and word-delete is the one thing the Cmd/Ctrl swap
             * cannot fix: firmware Ctrl becomes Command on the Mac, and
             * Cmd+Bspc is delete-to-line-start, not delete-word.
             *
             * These are identical on every typing layer, which is exactly
             * why a single overlay can carry them without colliding. */
            #define MAC_ESC   &to_BAS_mac_kp  0  ESC
            #define MAC_BSPC  &mt  LA(BSPC)  BSPC
            #define MAC_DEL   &mt  LA(DEL)   DEL

            display-name = "MAC";
            bindings = <
    MAC_ESC  &trans  &trans  &trans  &trans  &trans        &trans  &trans  &trans  &trans  &trans  MAC_BSPC
    MAC_DEL  &trans  &trans  &trans  &trans  &trans        &trans  &trans  &trans  &trans  &trans   &trans
     &trans  &trans  &trans  &trans  &trans  &trans        &trans  &trans  &trans  &trans  &trans   &trans
                             &trans  &trans  &trans        &trans  &trans  &trans
            >;
        };

        mac_settings_layer {
            /* Four keys, each the macOS spelling of something the shared
             * layer already does the Windows way at the same position:
             *
             *   12  input source      (shared: Win+Space)
             *   22  mission control   (shared: system info)
             *   28  finder            (shared: file explorer)
             *   34  application windows (shared: windows security)
             *
             * Everything else is &trans and comes from the shared layer.
             *
             * Volume, mute and the media keys deliberately do NOT appear
             * here: they are OS-independent HID consumer codes, so they
             * live once on the shared layer and sit at the same positions
             * on both machines. They used to be duplicated here at
             * different positions, and overriding 19-21 meant macOS had no
             * media keys at all.
             *
             * The Rectangle window-management and VS Code panel keys that
             * used to occupy nine slots here were removed as unused. They
             * depended on Rectangle being installed and on specific VS Code
             * keybindings, and two of the nine did nothing on tap. Recover
             * from git history if they're ever wanted.
             */
            #define MAC_INPUT    &kp LG(LA(SPACE))   // input source        (Ctrl+Opt+Space)
            #define MAC_MISSION  &kp LG(UP)          // mission control     (Ctrl+Up)
            #define MAC_APPWIN   &kp LG(DOWN)        // application windows (Ctrl+Down)
            #define MAC_FILES    &mp_mSTG_f          // finder | shift: show system files

            display-name = "MAC_STG";
            bindings = <
       &trans  &trans  &trans  &trans      &trans  &trans        &trans  &trans  &trans  &trans       &trans  &trans
    MAC_INPUT  &trans  &trans  &trans      &trans  &trans        &trans  &trans  &trans  &trans  MAC_MISSION  &trans
       &trans  &trans  &trans  &trans  MAC_FILES  &trans        &trans  &trans  &trans  &trans   MAC_APPWIN  &trans
                               &trans  &trans  &trans        &trans  &trans  &trans
            >;
        };
