        win_act_num_layer {
            /* WIN_AXN -- conditional on <WIN AXN>.
             *
             * Overrides the AXN positions whose macOS chord differs on
             * Windows. Everything else is &trans and falls through to AXN.
             *
             * Left shortcuts: Cmd+letter on Mac becomes Ctrl+letter here.
             * Row 0: Win+Sft+S (screenshot), then Ctrl+W/F/P/B
             * Row 1: Ctrl+A/R/S/T  (select-all, reload, save, new-tab)
             *        Ctrl+H at G position for replace (macOS uses Opt+Cmd+F)
             * Row 2: Ctrl+Z/X/C + paste (clipboard, same as Mac but native)
             *
             * Without this, AXN's Win+Z/X/C/V opens snap layouts, the
             * power-user menu, Copilot and clipboard history instead.
             *
             * AXN numpad positions 19-22 are plain &kp (no HRM), so no
             * per-OS swap is needed there. */

            display-name = "WIN_AXN";
            bindings = <
    &trans  &kp LG(LS(S))  &kp LC(W)  &kp LC(F)  &kp LC(P)  &kp LC(B)        &trans  &trans  &trans  &trans  &trans  &trans
    &trans  &kp LC(A)  &kp LC(R)  &kp LC(S)  &kp LC(T)  &kp LC(H)        &trans  &trans  &trans  &trans  &trans  &trans
    &trans  &kp LC(Z)  &kp LC(X)  &kp LC(C)  &kp LC(D)  &kp LC(V)    &trans  &trans  &trans   &trans   &trans  &trans
                            &trans  &trans  &trans        &trans  &trans  &trans
            >;
        };
