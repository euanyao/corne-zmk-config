/* WIN_STG -- layer 6, conditional on <WIN STG>.
 *
 * The one place the two OSes genuinely diverge. Ten positions, each the
 * Windows counterpart of what the shared settings layer does the macOS way,
 * or filling a slot macOS leaves empty.
 *
 * Must stay above STG, since it overrides positions STG binds. Cannot fold
 * into the WIN flag layer: these positions are letters on the typing
 * layers, so an always-on binding would break typing.
 *
 * The Windows machines carry a Win/Ctrl remap, so here: **want Control ->
 * write LG; want the Win key -> write LC.**
 *
 * Volume, mute and media are deliberately absent -- they are OS-independent
 * HID codes and live once on the shared layer. Overriding them here is what
 * previously left one OS with no media keys.
 *
 * Positions 31 and 32 are left &trans on purpose: 31 is the OS toggle on
 * STG and relies on falling through to stay self-inverse.
 */

        windows_settings_layer {
            /* Task manager sits at position 32, NOT 11.
             *
             * STG binds the right-half bootloader at 11. WIN_STG is the
             * higher layer, so anything bound here shadows it -- which in
             * Windows mode would silently swap DFU for task manager, the
             * worst possible failure for the only route into bootloader.
             * Position 32 is free on STG and was the only other slot that
             * is &trans here, so task manager moved there. */
            #define WS_PICK     &kp LC(LS(C))        // powertoys colour picker (Win+Shift+C)
            #define WS_MAG_IN   &kp LC(EQUAL)        // magnifier in    (Win+Plus)
            #define WS_MAG_OUT  &kp LC(MINUS)        // magnifier out   (Win+Minus)
            #define WS_MAG_OFF  &kp LC(ESC)          // magnifier off   (Win+Esc)
            #define WS_ZONES    &kp LC(LS(GRAVE))    // fancy zones     (Win+Shift+`)
            #define WS_TASKMGR  &kp LG(LS(ESC))      // task manager    (Ctrl+Shift+Esc)
            #define WS_SYSINFO  &kp RC(PAUSE_BREAK)  // system info     (Win+Pause)
            #define WS_SETTING  &kp RC(I)            // windows settings (Win+I)
            #define WS_SECURE   &kp LG(LA(DEL))      // security screen (Ctrl+Alt+Del)
            #define WS_FILES    &kp LC(E)            // file explorer   (Win+E)

            display-name = "WIN_STG";
            bindings = <
    &trans  &trans  &trans  &trans   WS_PICK  &trans        WS_MAG_IN   &trans  &trans      &trans    WS_ZONES      &trans
    &trans  &trans  &trans  &trans    &trans  &trans       WS_MAG_OFF   &trans  &trans      &trans  WS_SYSINFO  WS_SETTING
    &trans  &trans  &trans  &trans  WS_FILES  &trans       WS_MAG_OUT   &trans  WS_TASKMGR  &trans   WS_SECURE      &trans
                            &trans  &trans  &trans        &trans  &trans  &trans
            >;
        };
