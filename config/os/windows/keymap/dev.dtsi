win_dev_layer {
            /* WIN_DEV -- conditional on <WIN DEV>.
             *
             * HRM was removed, so there are no per-OS home-row differences
             * on DEV. This layer is entirely &trans; it is kept as a
             * placeholder for any future DEV-specific Windows divergence. */

            display-name = "WIN_DEV";
            bindings = <
    &trans  &trans  &trans  &trans  &trans  &trans        &trans  &trans  &trans  &trans  &trans  &trans
    &trans  &trans  &trans  &trans  &trans  &trans        &trans  &trans  &trans  &trans  &trans  &trans
    &trans  &trans  &trans  &trans  &trans  &trans        &trans  &trans  &trans  &trans  &trans  &trans
                            &trans  &trans  &trans        &trans  &trans  &trans
            >;
        };
