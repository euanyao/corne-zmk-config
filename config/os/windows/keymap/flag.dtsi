/* WIN -- layer 1, the OS flag. Lit means Windows.
 *
 * Almost entirely &trans. It exists to be a layer that stays on, because
 * "which layers are active" is the only runtime state ZMK has.
 *
 * It sits directly above BAS and BELOW the typing layers, which works only
 * because DEV/AXN/FNK are &trans at all three positions below. That
 * placement keeps the OLED useful -- it shows the highest active layer, so
 * a high WIN would mask the layer you're actually on. See
 * os/shared/layers.dtsi.
 *
 * macOS is the unflagged default. There is NO host remap any more: write
 * keycodes natively. On this layer LC is Control and LG is the Win key,
 * exactly as written.
 *
 * DEV and AXN have their own conditional overlays (WIN_DEV, WIN_AXN) for
 * the shortcuts that genuinely differ. This layer carries only what is
 * identical across every typing layer, which is why one overlay can hold it
 * without colliding.
 */

        windows_layer {
            /* ESC-hold has to relight the flag that &to clears, and
             * backspace word-delete differs by OS: the shared layer uses
             * Option+Bspc for macOS, Windows wants Ctrl+Bspc. Written
             * natively as LC now that there is no host remap.
             *
             * Backspace is at pos 37 (left middle thumb) -- the override
             * lives there. Pos 11 is now comma/Alt and has no word-delete.
             * Thumbs are &trans on every typing layer, so this override
             * reaches through them automatically.
             *
             * These are identical on every typing layer, which is exactly
             * why a single overlay can carry them without colliding. */
            #define WN_ESC   &to_BAS_win_kp  0  ESC
            #define WN_BSPC  &mt  LC(BSPC)  BSPC

            /* Outer-column and bottom-row modifier overrides.
             *
             * Pos 24 (Caps Lock) and pos 35 (backslash) hold LGUI on macOS;
             * Windows wants LCTRL (same tap, different hold param).
             *
             * Pos 25 (Z) and pos 34 (/) hold LCTRL on macOS; Windows wants
             * LGUI (Win key) instead -- same finger, opposite modifier. */
            #define WN_CAPS  &ht_LGUI_caps LCTRL 0
            #define WN_BSLH  &ht_LGUI_bslh LCTRL 0
            #define WN_Z     &mt LGUI Z
            #define WN_SLSH  &mt LGUI FSLH

            display-name = "WIN";
            bindings = <
    &trans  &trans  &trans  &trans  &trans  &trans        &trans  &trans  &trans  &trans  &trans  &trans
    &trans  &trans  &trans  &trans  &trans  &trans        &trans  &trans  &trans  &trans  &trans  &trans
    WN_CAPS  WN_Z  &trans  &trans  &trans  &trans        &trans  &trans  &trans  &trans  WN_SLSH  WN_BSLH
                          &trans  WN_BSPC  &trans        &trans  &trans  &trans
            >;
        };
