        win_fnk_nav_layer {
            /* WIN_FNK_NAV -- conditional on <WIN FNK_NAV>.
             *
             * HRM was removed, so there are no per-OS home-row differences
             * on FNK_NAV. This layer is entirely &trans; it is kept as a
             * placeholder for any future FNK_NAV-specific Windows divergence. */

            display-name = "WIN_FNK_NAV";
            bindings = <
    &trans  &trans  &trans  &trans  &trans  &trans        &trans  &trans  &trans  &trans  &trans  &trans
    &trans  &trans  &trans  &trans  &trans  &trans        &trans  &trans  &trans  &trans  &trans  &trans
    &trans  &trans  &trans  &trans  &trans  &trans        &trans  &trans  &trans  &trans  &trans  &trans
                        &trans  &trans  &trans        &trans  &trans  &trans
            >;
        };
