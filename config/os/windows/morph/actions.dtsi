/* Windows counterpart for mp_a_paste (os/shared/morph/actions.dtsi).
 *
 * NATIVE keycodes -- no host remap. LCTRL is Control, LGUI is Win key.
 */

// tap: paste          shift: paste without formatting
mp_wa_paste: morph_win_action_paste {
    compatible = "zmk,behavior-mod-morph";
    #binding-cells = <0>;
    mods = <(MOD_LSFT|MOD_RSFT)>;
    bindings = <&kp LC(V)>, <&kp LC(LS(V))>;
};
